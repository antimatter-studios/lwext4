## examples/esp-idf/main/Kconfig.projbuild
```kconfig
# SPDX-License-Identifier: BSD-3-Clause
menu "lwext4 example"

    choice EXAMPLE_SD
        prompt "SD card interface"
        default EXAMPLE_SD_NONE
        help
            Besides the two ext4 partitions in SPI flash, the example can
            also use an SD card. The card needs an MBR with partition 1 =
            an ext4 filesystem made on a PC (host/mkimage.sh sd) and
            partition 2 = spare space that the example formats itself.

        config EXAMPLE_SD_NONE
            bool "No SD card (SPI flash partitions only)"

        config EXAMPLE_SD_SDMMC
            bool "SDMMC host controller"
            depends on SOC_SDMMC_HOST_SUPPORTED
            help
                The dedicated SD/MMC controller (ESP32, ESP32-S3, ESP32-P4).
                On ESP32 slot 1 uses fixed pins: CLK=14, CMD=15, D0=2,
                D1=4, D2=12, D3=13. Espressif's QEMU emulates this
                controller for the ESP32.

        config EXAMPLE_SD_SDSPI
            bool "SPI bus (SD card module)"
            help
                A general purpose SPI controller in SD SPI mode: the usual
                wiring for breakout boards / micro SD modules, and the only
                option on chips without an SDMMC controller (ESP32-C3).
    endchoice

    config EXAMPLE_SDMMC_WIDTH_4
        bool "Use 4-bit SDMMC bus"
        depends on EXAMPLE_SD_SDMMC
        default y
        help
            4 data lines. Disable to use 1-bit mode (D0 only), e.g. on
            ESP32 modules where GPIO12 (D2) is a strapping pin that must
            not be pulled up at reset.

    if EXAMPLE_SD_SDSPI
        config EXAMPLE_SDSPI_MOSI
            int "MOSI GPIO"
            default 23 if IDF_TARGET_ESP32
            default 11 if IDF_TARGET_ESP32S3
            default 7
        config EXAMPLE_SDSPI_MISO
            int "MISO GPIO"
            default 19 if IDF_TARGET_ESP32
            default 13 if IDF_TARGET_ESP32S3
            default 2
        config EXAMPLE_SDSPI_CLK
            int "SCK GPIO"
            default 18 if IDF_TARGET_ESP32
            default 12 if IDF_TARGET_ESP32S3
            default 6
        config EXAMPLE_SDSPI_CS
            int "CS GPIO"
            default 5 if IDF_TARGET_ESP32
            default 10 if IDF_TARGET_ESP32S3
            default 10
    endif

    config EXAMPLE_TASK_STACK
        int "Stack size of the example task (bytes)"
        default 16384
endmenu
```

## examples/esp-idf/sdkconfig.defaults
```kconfig
# SPDX-License-Identifier: BSD-3-Clause
CONFIG_ESPTOOLPY_FLASHSIZE_16MB=y
CONFIG_PARTITION_TABLE_CUSTOM=y
CONFIG_PARTITION_TABLE_CUSTOM_FILENAME="partitions.csv"
CONFIG_COMPILER_OPTIMIZATION_SIZE=y
CONFIG_ESP_TASK_WDT_EN=n
CONFIG_FREERTOS_USE_TRACE_FACILITY=y
CONFIG_LWEXT4_CACHE_SIZE=16
CONFIG_LWEXT4_JOURNALING=y
```

## ports/esp-idf/lwext4/Kconfig
```kconfig
# SPDX-License-Identifier: BSD-3-Clause
menu "lwext4"

    choice LWEXT4_FEATURE_SET
        prompt "Supported filesystem feature set"
        default LWEXT4_FEATURE_SET_EXT4
        help
            Highest ext feature level lwext4 accepts when mounting. Images
            using incompatible features beyond this level are refused.

        config LWEXT4_FEATURE_SET_EXT2
            bool "ext2"
        config LWEXT4_FEATURE_SET_EXT3
            bool "ext3"
        config LWEXT4_FEATURE_SET_EXT4
            bool "ext4"
    endchoice

    config LWEXT4_JOURNALING
        bool "Journaling (ext3/ext4 jbd2 journal)"
        default y
        help
            Journal replay (ext4_recover) and journalled transactions
            (ext4_journal_start/stop). Strongly recommended on media that can
            lose power mid-write.

    config LWEXT4_XATTR
        bool "Extended attributes"
        default y
        help
            Compiles in src/ext4_xattr.c, which is licensed GPLv2 (the rest
            of lwext4 is BSD-3-Clause).

    config LWEXT4_EXTENTS
        bool "Extents"
        default y
        help
            Required to read and write files on ext4 images that use extents
            (the mke2fs default for ext4). Compiles in src/ext4_extent.c,
            which is licensed GPLv2 (the rest of lwext4 is BSD-3-Clause).

    config LWEXT4_CACHE_SIZE
        int "Block cache size (blocks)"
        range 4 1024
        default 16
        help
            Number of filesystem blocks kept in the lwext4 block cache. Each
            entry costs one filesystem block of heap (1 KiB - 4 KiB), plus
            some bookkeeping.

    config LWEXT4_BLOCKDEVS_COUNT
        int "Maximum number of registered block devices"
        range 1 16
        default 2

    config LWEXT4_MOUNTPOINTS_COUNT
        int "Maximum number of mount points"
        range 1 16
        default 2

    config LWEXT4_MAX_NAME
        int "Maximum block device / mount point name length"
        range 8 128
        default 32

    config LWEXT4_MAX_TRUNCATE_SIZE
        int "Maximum single truncate step (bytes)"
        default 16777216
        help
            Large truncates are split into steps of this size so a single
            transaction does not need unbounded memory.

    config LWEXT4_BLOCKDEV_STATS
        bool "Block device read/write counters"
        default y

    config LWEXT4_DEBUG_PRINTF
        bool "Debug printf support"
        default n
        help
            Compile in lwext4's debug messages. They are still filtered at
            run time with ext4_dmask_set(). Costs a lot of flash.

    config LWEXT4_DEBUG_ASSERT
        bool "Internal assertions"
        default n

    config LWEXT4_PARTITION_MMAP_READS
        bool "Flash partition block device: read through the flash cache"
        default y
        help
            Read flash partitions through a 64 KiB memory mapped window
            (esp_partition_mmap) instead of esp_partition_read(), which
            disables the flash cache (stalling the other CPU core) for every
            chunk it reads. Costs one 64 KiB window of the data address
            space per partition block device.

    config LWEXT4_PARTITION_SKIP_IDENTICAL
        bool "Flash partition block device: skip rewriting identical sectors"
        default y
        help
            The esp_partition block device has to erase a 4 KiB flash sector
            before writing it. With this option the sector is read first and
            the erase/program cycle is skipped when the data is unchanged,
            which saves flash wear for metadata that lwext4 rewrites often.

endmenu
```

## ports/zephyr/Kconfig
```kconfig
# SPDX-License-Identifier: BSD-3-Clause
#
# lwext4 options (menuconfig: Modules -> lwext4). They are mapped onto
# lwext4's own CONFIG_* switches by include/generated/ext4_config.h.

menuconfig LWEXT4
	bool "lwext4 ext2/ext3/ext4 file system library"
	help
	  lwext4: format, mount, read and write ext2/ext3/ext4 file systems
	  through its own API (ext4_fopen(), ext4_dir_mk(), ...) on any block
	  device, e.g. a disk of the disk access API (LWEXT4_DISK_ACCESS).
	  lwext4 allocates its block cache and journal records with malloc(),
	  so the C library needs a heap.

if LWEXT4

choice LWEXT4_FEATURE_SET
	prompt "Supported file system feature set"
	default LWEXT4_FEATURE_SET_EXT4
	help
	  Highest ext feature level lwext4 accepts when mounting. File
	  systems using incompatible features beyond this level are refused.

config LWEXT4_FEATURE_SET_EXT2
	bool "ext2"

config LWEXT4_FEATURE_SET_EXT3
	bool "ext3"

config LWEXT4_FEATURE_SET_EXT4
	bool "ext4"

endchoice

config LWEXT4_JOURNALING
	bool "Journaling (ext3/ext4 jbd2 journal)"
	default y
	help
	  Journal replay (ext4_recover()) and journalled transactions
	  (ext4_journal_start()/ext4_journal_stop()). Strongly recommended on
	  media that can lose power in the middle of a write.

config LWEXT4_EXTENTS
	bool "Extents"
	default y
	help
	  Needed to read and write files on ext4 file systems that use
	  extents (the mke2fs default for ext4). Compiles in
	  src/ext4_extent.c, which is licensed GPLv2 (the rest of lwext4 is
	  BSD-3-Clause).

config LWEXT4_XATTR
	bool "Extended attributes"
	default y
	help
	  Compiles in src/ext4_xattr.c, which is licensed GPLv2 (the rest of
	  lwext4 is BSD-3-Clause).

config LWEXT4_CACHE_SIZE
	int "Block cache size (blocks)"
	range 4 1024
	default 8
	help
	  Number of file system blocks kept in lwext4's block cache. Each
	  entry costs one file system block of heap (1 KiB - 4 KiB) plus some
	  bookkeeping. Blocks the journal still references stay in the cache
	  beyond this number until they are written back.

config LWEXT4_BLOCKDEVS_COUNT
	int "Maximum number of registered block devices"
	range 1 16
	default 2

config LWEXT4_MOUNTPOINTS_COUNT
	int "Maximum number of mount points"
	range 1 16
	default 2

config LWEXT4_MAX_NAME
	int "Maximum block device and mount point name length"
	range 8 128
	default 32

config LWEXT4_MAX_TRUNCATE_SIZE
	int "Maximum single truncate step (bytes)"
	default 16777216
	help
	  Large truncates are split into steps of this size so that a single
	  transaction does not need unbounded memory.

config LWEXT4_BLOCKDEV_STATS
	bool "Block device read/write counters"

config LWEXT4_DEBUG_PRINTF
	bool "Debug messages"
	help
	  Compile in lwext4's debug messages (printf). They are still
	  filtered at run time with ext4_dmask_set(). Costs a lot of flash.

config LWEXT4_DEBUG_ASSERT
	bool "Internal assertions"
	help
	  lwext4's internal consistency checks, reported through the C
	  library's assert(), which stops the system with a fatal error.

config LWEXT4_DISK_ACCESS
	bool "Block device on the disk access API"
	default y
	depends on DISK_ACCESS
	help
	  ext4_zephyr_disk_init() (ext4_zephyr.h): an lwext4 block device on a
	  disk of Zephyr's disk access API, e.g. an SD card
	  (zephyr,sdmmc-disk), eMMC, NVMe, a RAM disk (zephyr,ram-disk) or a
	  flash disk.

config LWEXT4_DISK_MAX_SECTOR_SIZE
	int "Largest disk sector size supported (bytes)"
	default 512
	depends on LWEXT4_DISK_ACCESS
	help
	  Size of the one sector buffer each block device keeps for lwext4's
	  partial block accesses. Disks with larger sectors are refused.

endif # LWEXT4
```
